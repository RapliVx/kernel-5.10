## drivers/block/zram/Kconfig
```kconfig
# SPDX-License-Identifier: GPL-2.0
config ZRAM
	tristate "Compressed RAM block device support"
	depends on BLOCK && SYSFS && ZSMALLOC && CRYPTO
	select CRYPTO_LZO
	help
	  Creates virtual block devices called /dev/zramX (X = 0, 1, ...).
	  Pages written to these disks are compressed and stored in memory
	  itself. These disks allow very fast I/O and compression provides
	  good amounts of memory savings.

	  It has several use cases, for example: /tmp storage, use as swap
	  disks and maybe many more.

	  See Documentation/admin-guide/blockdev/zram.rst for more information.

config ZRAM_WRITEBACK
       bool "Write back incompressible or idle page to backing device"
       depends on ZRAM
       help
	 With incompressible page, there is no memory saving to keep it
	 in memory. Instead, write it out to backing device.
	 For this feature, admin should set up backing device via
	 /sys/block/zramX/backing_dev.

	 With /sys/block/zramX/{idle,writeback}, application could ask
	 idle page's writeback to the backing device to save in memory.

	 See Documentation/admin-guide/blockdev/zram.rst for more information.

config ZRAM_MEMORY_TRACKING
	bool "Track zRam block status"
	depends on ZRAM && DEBUG_FS
	help
	  With this feature, admin can track the state of allocated blocks
	  of zRAM. Admin could see the information via
	  /sys/kernel/debug/zram/zramX/block_state.

	  See Documentation/admin-guide/blockdev/zram.rst for more information.

config HYBRIDSWAP
	bool "Enable Universal Hybridswap for Android GKI"
	depends on MEMCG && ZRAM && ANDROID_VENDOR_HOOKS
	select ANDROID_VENDOR_OEM_DATA
	default n
	help
	  Universal Hybridswap tiered memory management and swap subsystem
	  for Android Generic Kernel Image (GKI). Manages DRAM, ZRAM, and
	  backing storage using standard Android vendor hooks and cgroup
	  accounting across any supported GKI platform.

config HYBRIDSWAP_SWAPD
	bool "Enable hybridswap swapd thread to reclaim anon pages in background"
	default y
	depends on HYBRIDSWAP
	help
	  swapd is a kernel thread that reclaims anonymous pages in the
	  background. When the use of swap pages reaches the watermark
	  and the refault of anonymous pages is high, the content of
	  zram will be swapped to backing storage.

config HYBRIDSWAP_CORE
	bool "Hybridswap container device support"
	depends on HYBRIDSWAP
	default y
	help
	  Say Y here if you want to use the hybridswap
	  as the backend device in ZRAM.
	  This module is part of the ZRAM driver.
```
